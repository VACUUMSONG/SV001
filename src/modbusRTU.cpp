#include "modbusRTU.h"
#include "hex2dec.h"
#include <string.h>

// 中菱 电机驱动 Modbus协议
String data = "";  // 接收到的16进制字符串

// Modbus CRC
unsigned short CRC16(unsigned char *puchMsg, unsigned short usDataLen)
{
	unsigned char uchCRCHi = 0xFF; /* 高字节初始化值   */
	unsigned char uchCRCLo = 0xFF; /* 低字节初始化值   */
	unsigned uIndex;

	// CRC校验查表
	static unsigned char auchCRCHi[] = {
	0x00, 0xC1, 0x81, 0x40, 0x01, 0xC0, 0x80, 0x41, 0x01, 0xC0, 0x80, 0x41, 0x00, 0xC1, 0x81,
	0x40, 0x01, 0xC0, 0x80, 0x41, 0x00, 0xC1, 0x81, 0x40, 0x00, 0xC1, 0x81, 0x40, 0x01, 0xC0,
	0x80, 0x41, 0x01, 0xC0, 0x80, 0x41, 0x00, 0xC1, 0x81, 0x40, 0x00, 0xC1, 0x81, 0x40, 0x01,
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	0x00, 0xC1, 0x81, 0x40, 0x01, 0xC0, 0x80, 0x41, 0x01, 0xC0, 0x80, 0x41, 0x00, 0xC1, 0x81,
	0x40};

	static char auchCRCLo[] = {
	0x00, 0xC0, 0xC1, 0x01, 0xC3, 0x03, 0x02, 0xC2, 0xC6, 0x06, 0x07, 0xC7, 0x05, 0xC5, 0xC4,
	0x04, 0xCC, 0x0C, 0x0D, 0xCD, 0x0F, 0xCF, 0xCE, 0x0E, 0x0A, 0xCA, 0xCB, 0x0B, 0xC9, 0x09,
	0x08, 0xC8, 0xD8, 0x18, 0x19, 0xD9, 0x1B, 0xDB, 0xDA, 0x1A, 0x1E, 0xDE, 0xDF, 0x1F, 0xDD,
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	0x44, 0x84, 0x85, 0x45, 0x87, 0x47, 0x46, 0x86, 0x82, 0x42, 0x43, 0x83, 0x41, 0x81, 0x80,
	0x40};
	while (usDataLen--)
	{
		uIndex = uchCRCLo ^ *puchMsg++;
		uchCRCLo = uchCRCHi ^ auchCRCHi[uIndex];
		uchCRCHi = auchCRCLo[uIndex];
	}
	return (uchCRCHi << 8 | uchCRCLo);
}

ModbusRTU::ModbusRTU() {
}

ModbusRTU::~ModbusRTU(){
}

void ModbusRTU::init()
{
	HardwareSerial Serial_Modbus(PIN_U5_RX, PIN_U5_TX);
	HardwareSerial Serial_BM1684(PIN_U1_RX, PIN_U1_TX);

	//串口初始化
	Serial_Modbus.begin(115200);
	Serial_Modbus.println("UART Modbus Init...");
	delay(200);
	Serial_BM1684.begin(115200);
	Serial_BM1684.println("UART BM1684 Init...");
	delay(200);
}

// 不断执行
void ModbusRTU::spin(){
	
}

uint8_t ModbusRTU::toHex(int val) {  
	// HardwareSerial Serial_BM1684(PIN_U1_RX, PIN_U1_TX);
	// Serial_BM1684.begin(115200);

	char resHex =  (char) (val%16 & 0x0F) | (val/16 << 4);  
	// Serial_BM1684.println(resHex,HEX);
	delay(200);
	
	return resHex;
}

// 命令发送
void ModbusRTU::mb_Send_Cmd(uint8_t cmd[],uint8_t len)
{
	HardwareSerial Serial_Modbus(PIN_U5_RX, PIN_U5_TX);
	Serial_Modbus.begin(115200);
	
	// 数据请求
	for (int i = 0; i < len; i++) {
		Serial_Modbus.write(cmd[i]); // write输出
	}
	delay(200); //等待读取完成
}

// 速度反馈
void ModbusRTU::mb_Speed_callBack() {

	HardwareSerial Serial_Modbus(PIN_U5_RX, PIN_U5_TX);
	Serial_Modbus.begin(115200);

	uint8_t mb_getSpeed_TwoMotor[8]={0x01, 0x03, 0x20, 0xAB, 0x00, 0x02, 0xBE, 0x2B};
	// 数据请求
	for (int i = 0; i < 8; i++) {
		Serial_Modbus.write(mb_getSpeed_TwoMotor[i]); // write输出
	}
	delay(200); //等待读取完成

	while (Serial_Modbus.available())	
	{
		Serial_Modbus.read();
	}
	
}

// 故障清除
void ModbusRTU::mb_Cls_Error() {
	uint8_t mb_clsError[8] = {0x01, 0x06, 0x20, 0x0E, 0x00, 0x06, 0x63, 0xCB};
	mb_Send_Cmd(mb_clsError,8);
}

// 电机急停
void ModbusRTU::mb_Set_Motor_EmerganceyStop()
{
	uint8_t mb_setEmergencyStop[8] = {0x01, 0x06, 0x20, 0x0E, 0x00, 0x05, 0x23, 0xCA};
	mb_Send_Cmd(mb_setEmergencyStop,8);
}

// 电机停机
void ModbusRTU::mb_Set_Motor_Stop(){
	uint8_t mb_setStop[8] = {0x01, 0x06, 0x20, 0x0E, 0x00, 0x07, 0xA2, 0x0B};
	mb_Send_Cmd(mb_setStop,8);
}

// 电机使能
void ModbusRTU::mb_Set_Motor_Enable() {
	
	// 设置速度模式
	uint8_t mb_setMode_Speed[8] = {0x01, 0x06, 0x20, 0x0D, 0x00, 0x03, 0x53, 0xC8};
	mb_Send_Cmd(mb_setMode_Speed,8);
	// S型加减速时间设定
	// TODO
	// 电机使能
	uint8_t mb_setStart[8] = {0x01, 0x06, 0x20, 0x0E, 0x00, 0x08, 0xE2, 0x0F};
	mb_Send_Cmd(mb_setStart,8);

	// // 左右电机同步转速设定100rpm
	// uint8_t mb_setSpeed_LR[13] = {0x01, 0x10, 0x20, 0x88, 0x00, 0x02, 0x04, 0x00, 0x64, 0x00, 0x64, 0x23, 0x9C};
	// mb_Send_Cmd(mb_setSpeed_LR,13);
}

// 转速同步 
void ModbusRTU::mb_Set_Motor_Speed() {
	// 左右电机同步转速设定100rpm

	// 左转
	// uint8_t mb_setSpeed_LR[13] = {0x01, 0x10, 0x20, 0x88, 0x00, 0x02, 0x04, 0x00, 0x64, 0x00, 0x64, 0x23, 0x9C};
	// 前进
	uint8_t mb_setSpeed_LR[13] = {0x01, 0x10, 0x20, 0x88, 0x00, 0x02, 0x04, 0xFF, 0x9C, 0x00, 0x64, 0x92, 0x79};
	
	mb_Send_Cmd(mb_setSpeed_LR,13);
}

// 转速设定 -> 左电机
void ModbusRTU::mb_Set_Left_Moto(int rpm) {
	
	//串口初始化
	HardwareSerial Serial_Modbus(PIN_U5_RX, PIN_U5_TX);
	Serial_Modbus.begin(115200);
	HardwareSerial Serial_BM1684(PIN_U1_RX, PIN_U1_TX);
	Serial_BM1684.begin(115200);

	// rpm 限幅
    if (rpm > MAX_RPM) {
        rpm = MAX_RPM;
    } else if (rpm < MIN_RPM) {
        rpm = MIN_RPM;
    }

	uint8_t mb_setSpeed_cmd[8]={};
	uint8_t mb_setSpeed_LM[4] = {0x01, 0x06, 0x20, 0x88};

	for(char i=0;i<4;i++){
		mb_setSpeed_cmd[i]=mb_setSpeed_LM[i];
	}

	if(rpm>0){ //高八位 0x00
		mb_setSpeed_cmd[4]=0x00;
		mb_setSpeed_cmd[5]= toHex(rpm);
	}else{
		mb_setSpeed_cmd[4]=0xFF;
		mb_setSpeed_cmd[5]= toHex(255+rpm);
	}

	unsigned short myCRC = CRC16(mb_setSpeed_cmd,6);
	mb_setSpeed_cmd[6]=myCRC&0xFF;
	mb_setSpeed_cmd[7]=(myCRC>>8)&0xFF;

	mb_Send_Cmd(mb_setSpeed_cmd,8);	
}

// 转速设定 -> 右电机
void ModbusRTU::mb_Set_Right_Moto(int rpm) {
	// rpm 限幅
    if (rpm > MAX_RPM) {
        rpm = MAX_RPM;
    } else if (rpm < MIN_RPM) {
        rpm = MIN_RPM;
    }
	uint8_t mb_setSpeed_cmd[8]={};
	uint8_t mb_setSpeed_RM[4] = {0x01, 0x06, 0x20, 0x89};

	for(char i=0;i<4;i++){
		mb_setSpeed_cmd[i]=mb_setSpeed_RM[i];
	}

	int8_t rpmHex={};
	if(rpm>0){ //高八位 0x00
		mb_setSpeed_cmd[4]= 0x00;
		mb_setSpeed_cmd[5]= toHex(rpm);
	}else{
		mb_setSpeed_cmd[4]=0xFF;
		mb_setSpeed_cmd[5]= toHex((255+rpm));
	}

	unsigned short myCRC = CRC16(mb_setSpeed_cmd,6);
	mb_setSpeed_cmd[6]=myCRC&0xFF;
	mb_setSpeed_cmd[7]=(myCRC>>8)&0xFF;

	mb_Send_Cmd(mb_setSpeed_cmd,8);	
}

/*------------------*/
//  获取编码器速度
//  单位：RPM
/*------------------*/
int16_t ModbusRTU::mb_Get_LeftMotor_RPA() {

	HardwareSerial Serial_Modbus(PIN_U5_RX, PIN_U5_TX);
	HardwareSerial Serial_BM1684(PIN_U1_RX, PIN_U1_TX);
	Serial_BM1684.begin(115200);
	Serial_Modbus.begin(115200);

	// 获取电机速度
	uint8_t mb_getSpeed_TwoMotor[8]={0x01, 0x03, 0x20, 0xAB, 0x00, 0x02, 0xBE, 0x2B};
	// 数据请求
	for (int i = 0; i < 8; i++) {
		Serial_Modbus.write(mb_getSpeed_TwoMotor[i]); // write输出
	}
	delay(200); //等待读取完成

	// 数据接收及解析
	String data="";
	char mySpeedRpm[2]="";

	while (Serial_Modbus.available())
	{ 
		// 从串口中读取数据
		data += (char)Serial_Modbus.read(); // read读取
		Serial_Modbus.flush();
	}

	char lm_rpm_flag = data.charAt(3);
	char lm_rpm_num  = data.charAt(4);

	int resData= int(lm_rpm_flag)*256 +int(lm_rpm_num);
	
	Serial_BM1684.print("-----LM-------");	
	delay(200);
	if(resData<2560){
		Serial_BM1684.print(resData);	
	}else{
		Serial_BM1684.print(resData-65535);	
	}
	delay(200);
	Serial_BM1684.print("-------------");	
	delay(200);

	data = "";

	if(resData < 2560){
		return resData;
	}else {
		return (resData -65536);
	}
}


int16_t ModbusRTU::mb_Get_RightMotor_RPA() {

	HardwareSerial Serial_Modbus(PIN_U5_RX, PIN_U5_TX);
	HardwareSerial Serial_BM1684(PIN_U1_RX, PIN_U1_TX);
	Serial_BM1684.begin(115200);
	Serial_Modbus.begin(115200);

	// 获取电机速度
	uint8_t mb_getSpeed_TwoMotor[8]={0x01, 0x03, 0x20, 0xAB, 0x00, 0x02, 0xBE, 0x2B};
	// 数据请求
	for (int i = 0; i < 8; i++) {
		Serial_Modbus.write(mb_getSpeed_TwoMotor[i]); // write输出
	}
	delay(200); //等待读取完成

	// 数据接收及解析
	String data="";
	char mySpeedRpm[2]="";

	while (Serial_Modbus.available())
	{ 
		// 从串口中读取数据
		data += (char)Serial_Modbus.read(); // read读取
		Serial_Modbus.flush();
	}

	char rm_rpm_flag = data.charAt(5);
	char rm_rpm_num  = data.charAt(6);

	int resData= int(rm_rpm_flag)*256 +int(rm_rpm_num);
	
	Serial_BM1684.print("-----RM-------");	
	delay(200);
	if(resData<2560){
		Serial_BM1684.print(resData);	
	}else{
		Serial_BM1684.print(resData-65535);	
	}
	delay(200);
	Serial_BM1684.print("-------------");	
	delay(200);
	data = "";

	if(resData < 2560){
		return resData;
	}else{
		return (resData -65536);
	}
}